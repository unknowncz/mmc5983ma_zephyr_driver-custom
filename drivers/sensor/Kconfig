## drivers/sensor/Kconfig
```kconfig
menuconfig MMC5983MA
	bool "MMC5983MA Magnetometer IC"
	default y
	depends on DT_HAS_MEMSIC_MMC5983MA_ENABLED

if MMC5983MA

choice MMC5983MA_TRIGGER_MODE
	prompt "Trigger mode"
	help
	  Specify the type of triggering to be used by the driver.

config MMC5983MA_TRIGGER_NONE
	bool "No trigger"

config MMC5983MA_TRIGGER_GLOBAL_THREAD
	bool "Use global thread"
	depends on GPIO
	depends on $(dt_compat_any_has_prop,$(DT_COMPAT_MEMSIC_MMC5983MA),irq-gpios)
	select MMC5983MA_TRIGGER

config MMC5983MA_TRIGGER_OWN_THREAD
	bool "Use own thread"
	depends on GPIO
	depends on $(dt_compat_any_has_prop,$(DT_COMPAT_MEMSIC_MMC5983MA),irq-gpios)
	select MMC5983MA_TRIGGER

endchoice

config MMC5983MA_TRIGGER
	bool

config MMC5983MA_THREAD_PRIORITY
	int "Thread priority"
	depends on MMC5983MA_TRIGGER_OWN_THREAD
	default 10
	help
	  Priority of thread used by the driver to handle interrupts.

config MMC5983MA_THREAD_STACK_SIZE
	int "Thread stack size"
	depends on MMC5983MA_TRIGGER_OWN_THREAD
	default 1024
	help
	  Stack size of thread used by the driver to handle interrupts.

endif
```

## dts/bindings/sensor/mmc5983ma.yaml
```yaml
compatible: "memsic,mmc5983ma"

include: [base.yaml, i2c-device.yaml, sensor-device.yaml]

description: |
  MMC5983MA Magnetic Sensor

properties:
  irq-gpios:
    type: phandle-array
    description: |
      The INT signal connection.
```
